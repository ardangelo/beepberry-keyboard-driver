// SPDX-License-Identifier: GPL-2.0
/dts-v1/;
/plugin/;

/{
	compatible = "brcm,bcm2835";

	fragment@0 {
		target = <&i2c1>;

		__overlay__ {
			#address-cells = <1>;
			#size-cells = <0>;
			beepy_kbd: beepy_kbd@1f {
				#address-cells = <1>;
				compatible = "beepy-kbd";
				reg = <0x1F>;
				irq-gpio = <&gpio 11 0x2>;
				interrupts = <11 2>;
				interrupt-parent = <&gpio>;
				interrupt-controller;
				#interrupt-cells = <1>;
			};
		};
	};
	__overrides__ {
		irq_pin = <&beepy_kbd>,"interrupts:0";
	};
};

