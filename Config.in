## Config.in
```kconfig
config BR2_PACKAGE_BBQX0KBD
	bool "bbqx0kbd"
	default y
	depends on BR2_LINUX_KERNEL
	select BR2_PACKAGE_I2C
	select BR2_PACKAGE_SPI
	select BR2_PACKAGE_GPIO
	select BR2_PACKAGE_RASPI_GPIO
	help
	  Kernel driver for Beepberry keyboard
```
