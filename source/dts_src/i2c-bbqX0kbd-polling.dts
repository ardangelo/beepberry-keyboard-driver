// SPDX-License-Identifier: GPL-2.0
/dts-v1/;
/plugin/;

/{
	compatible = "brcm,bcm2835";

	fragment@0 {
		target = <&i2c1>;

		__overlay__ {
			#address-cells = <1>;
			#size-cells = <0>;
			bbqX0kbd: bbqX0kbd@1f {
				compatible = "wallComputer,bbqX0kbd";
				reg = <0x1F>;
			};
		};
	};
};
